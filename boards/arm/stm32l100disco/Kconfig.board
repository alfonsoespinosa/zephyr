## boards/arm/stm32l100disco/Kconfig.board
```kconfig
# Board configuration

# Copyright (c) 2019 eTactica ehf
# SPDX-License-Identifier: Apache-2.0

config BOARD_STM32L100DISCO
	bool "STM32L100DISCOVERY Development Board"
	depends on SOC_STM32L100XC
```

## boards/arm/stm32l100disco/Kconfig.defconfig
```kconfig
# Board configuration

# Copyright (c) 2019 eTactica ehf
# SPDX-License-Identifier: Apache-2.0

if BOARD_STM32L100DISCO

config BOARD
	default "stm32l100disco"

endif # BOARD_STM32L100DISCO
```

## soc/arm/st_stm32/stm32l1/Kconfig.defconfig.stm32l100xc
```kconfig
# ST Microelectronics STM32L151XB MCU

# Copyright (c) 2019 Linaro Ltd.
# SPDX-License-Identifier: Apache-2.0

if SOC_STM32L100XC

config SOC
	default "stm32l100xc"

config NUM_IRQS
	default 45

endif # SOC_STM32L100XC
```
